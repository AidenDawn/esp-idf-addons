## ds3231/Kconfig.projbuild
```kconfig
menu "DS3231 RTC Configuration"

    choice ENABLE
        prompt "Enable DS3231 RTC"
        default DS3231_RTC_ENABLED
        help
            Enable/Disable DS3231 RTC.
        config DS3231_RTC_ENABLED
            bool "DS3231 Enabled"
        config DS3231_RTC_DISABLED
            bool "DS3231 Disabled"
    endchoice

    if DS3231_RTC_ENABLED
            
        config DS3231_SCL_GPIO
            int "SCL GPIO number"
            range 0 34
            default 22
            help
                GPIO number (IOxx) to I2C SCL.
                Some GPIOs are used for other purposes (flash connections, etc.) and cannot be used to I2C.
                GPIOs 35-39 are input-only so cannot be used as outputs.
            
        config DS3231_SDA_GPIO
            int "SDA GPIO number"
            range 0 34
            default 21
            help
                GPIO number (IOxx) to I2C SDA.
                Some GPIOs are used for other purposes (flash connections, etc.) and cannot be used to I2C.
                GPIOs 35-39 are input-only so cannot be used as outputs.
            
        config DS3231_INT_GPIO
            int "INTERRUPT GPIO number"
            range -1 34
            default 23
            help
                GPIO number (IOxx) to INTERRUPT.
                When it is -1, INTERRUPT isn't performed.
                Some GPIOs are used for other purposes (flash connections, etc.) and cannot be used to Reset.
                GPIOs 35-39 are input-only so cannot be used as outputs.
            
    endif

endmenu
```

## ssd1306/Kconfig.projbuild
```kconfig
menu "SSD1306 Configuration"

    choice INTERFACE
        prompt "Interface"
        default I2C_INTERFACE
        help
            Select Interface.
        config SSD1306_I2C_INTERFACE
            bool "I2C Interface"
            help
                I2C Interface.
        config SSD1306_SPI_INTERFACE
            bool "SPI Interface"
            help
                SPI Interface.
    endchoice

if SSD1306_I2C_INTERFACE

    choice PANEL
        prompt "Panel Type"
        default SSD1306_128x64
        help
            Select Panel Type.
        config SSD1306_128x32
            bool "128x32 Panel"
            help
                Panel is 128x32.
        config SSD1306_128x64
            bool "128x64 Panel"
            help
                Panel is 128x64.
    endchoice

    config SSD1306_SCL_GPIO
        int "SCL GPIO number"
        range 0 34
        default 22
        help
            GPIO number (IOxx) to I2C SCL.
            Some GPIOs are used for other purposes (flash connections, etc.) and cannot be used to I2C.
            GPIOs 35-39 are input-only so cannot be used as outputs.

    config SSD1306_SDA_GPIO
        int "SDA GPIO number"
        range 0 34
        default 21
        help
            GPIO number (IOxx) to I2C SDA.
            Some GPIOs are used for other purposes (flash connections, etc.) and cannot be used to I2C.
            GPIOs 35-39 are input-only so cannot be used as outputs.

endif

    config SSD1306_RESET_GPIO
        int "RESET GPIO number"
        range -1 34
        default -1
        help
            GPIO number (IOxx) to RESET.
            When it is -1, RESET isn't performed.
            Some GPIOs are used for other purposes (flash connections, etc.) and cannot be used to Reset.
            GPIOs 35-39 are input-only so cannot be used as outputs.

if SSD1306_SPI_INTERFACE
    config SSD1306_CS_GPIO
        int "CS GPIO number"
        range 0 34
        default 15
        help
            GPIO number (IOxx) to SPI CS.
            Some GPIOs are used for other purposes (flash connections, etc.) and cannot be used to CS.
            GPIOs 35-39 are input-only so cannot be used as outputs.

    config SSD1306_DC_GPIO
        int "DC GPIO number"
        range 0 34
        default 33
        help
            GPIO number (IOxx) to SPI DC.
            Some GPIOs are used for other purposes (flash connections, etc.) and cannot be used to DC.
            GPIOs 35-39 are input-only so cannot be used as outputs.

endif

endmenu
```
